## config/west.yml
```yaml
manifest:
  remotes:
    - name: zmkfirmware
      url-base: https://github.com/zmkfirmware
    - name: fifi
      url-base: https://github.com/hmngwy
  projects:
    - name: zmk
      remote: fifi
      revision: main
      import: app/west.yml
  self:
    path: config
```
